## components/iic/Kconfig
```kconfig
menu "GSDC IIC Configuration"

    config GSDC_IIC_OVERRIDE_CONFIGURATION_FILE_NAME 
        bool "Override the default file name"
        default n
        help
            You can set the file name to whatever you like (within reason).

    if GSDC_IIC_OVERRIDE_CONFIGURATION_FILE_NAME
        menu "rename configuration file"
            config GSDC_IIC_CONFIGURATION_FILE_NAME
                string "Configuration file name"
                default "iic.cfg"
                help
                    The name to use for the file holding the IIC configuration
        endmenu
    endif # GSDC_IIC_OVERRIDE_CONFIGURATION_FILE_NAME 

    config GSDC_IIC_SCL_PIN
        int "IIC SCL pin"
        default 22
        help
            which GPIO pin to use for the IIC clock line

    config GSDC_IIC_SCL_FREQUENCY
        int "IIC clock frequency (Hertz)"
        default 240000
        help
            The frequency of the IIC clock. defaults to 240kHz
    
    config GSDC_IIC_SDA_PIN
        int "IIC SDA pin"
        default 21
        help
            which GPIO pin to use for the IIC data line
        
    choice GSDC_IIC_MASTER_MODE
        prompt "IIC Role selection"
        default GSDC_IIC_IS_MASTER 

        config GSDC_IIC_IS_MASTER
            bool "This is a server IIC device"
        config GSDC_IIC_IS_SLAVE
            bool "This is a client IIC device"
    endchoice

    if GSDC_IIC_IS_MASTER
            config GSDC_IIC_POLLING_PERIOD
                int "Set the polling period in millisconds"
                default 1000
    endif

    if GSDC_IIC_IS_SLAVE
        choice TEST_MESSAGE_DATA_CHOICE
            prompt "Do you want to use test data for IIC client?"
            default USE_TEST_MESSAGE_DATA

            config DO_NOT_USE_TEST_MESSAGE_DATA
                bool "Do not use test IIC data"
            config USE_TEST_MESSAGE_DATA
                bool "Use builtin test IIC data"
        endchoice
    endif

    if USE_TEST_MESSAGE_DATA
        choice GSDC_IIC_TEST_MESSAGE_DATA
            prompt "Select the size of the test data returned from this client device"
            default GSDC_IIC_SLAVE_MESSAGE_8_BYTE

            config GSDC_IIC_SLAVE_MESSAGE_8_BYTE
                bool "8"
            config GSDC_IIC_SLAVE_MESSAGE_16_BYTE
                bool "16"
            config GSDC_IIC_SLAVE_MESSAGE_32_BYTE
                bool "32"
            config GSDC_IIC_SLAVE_MESSAGE_64_BYTE
                bool "64"
            config GSDC_IIC_SLAVE_MESSAGE_128_BYTE
                bool "128"
            config GSDC_IIC_SLAVE_MESSAGE_256_BYTE
                bool "256"
            config GSDC_IIC_SLAVE_MESSAGE_512_BYTE
                bool "512"
            config GSDC_IIC_SLAVE_MESSAGE_1K
                bool "1024"
            config GSDC_IIC_SLAVE_MESSAGE_2K
                bool "2048"
        endchoice
    endif

endmenu
```

## components/led_controller/Kconfig
```kconfig
menu "GSDC LED Controller parameters"

    config ENV_GPIO_RANGE_MIN
        int
        default 0
           
   config ENV_GPIO_OUT_RANGE_MAX
        int
        default 33

    config READ_GPIO
        int "Read LED GPIO number"
        range ENV_GPIO_RANGE_MIN ENV_GPIO_OUT_RANGE_MAX
        default 32 
        help
            GPIO number (IOxx) connected to an LED for indicating that data are being read from the IIC Bus.
            
            Some GPIOs are used for other purposes (flash connections, etc.) and cannot be used to blink.
            
            Make sure to set the pin to OUTPUT
    
    config WRITE_GPIO
        int "Write LED GPIO number"
        range ENV_GPIO_RANGE_MIN ENV_GPIO_OUT_RANGE_MAX
        default 33 
        help
            GPIO number (IOxx) connected to an LED for indicating that writing to the IIC Bus is taking place.

            Some GPIOs are used for other purposes (flash connections, etc.) and cannot be used to blink.

            Make sure to set the pin to OUTPUT
    
    config BLINK_PERIOD
        int "Blink period in ms"
        range 10 3600000
        default 10
        help
            Define the blinking period in milliseconds. 
            
            NOTE: Currently not used for anything
endmenu
```

## components/spiffs_file/Kconfig
```kconfig
menu "GSDC SPIFFS Configuration"

    config GSDC_SPIFFS_CHECK_ON_START
        bool "Run SPIFFS_check on every start-up"
        default y
        help
            If this config item is set, esp_spiffs_check() will be run on every start-up.
            Slow on large flash sizes.

    config GSDC_SPIFFS_PARTITION_LABEL
        string "Named partition"
        default "configuration"
        help
            This is the name of the partition used to store the configuration file.
            It is possible to have multiple partitions. The partition layout is found
            in the Custom CSV file specified above in the Partition table section

    config GSDC_SPIFFS_CONFIG_FILE_SYSTEM_ROOT
        string "File System root"
        default "/fs"

    choice GSDC_SPIFFS_INCLUDE_PARTITION_IMAGE_IN_BUILD
        prompt "Create the Partition Image when building the solution"
        default GSDC_SPIFFS_INCLUDE_PARTITION_IMAGE
        help
            Selecting 'Include Partition Image' causes the partition image to be created as part of the build. This 
            will then be included in the flash process.

            Selecting 'Exclude Partition Image' causes the partition image to not be created as part of the build. The 
            Partition Image is not in the flash process.

            NOTE: You can always upload the Partition Image manually

        config GSDC_SPIFFS_EXCLUDE_PARTITION_IMAGE
            bool "Exclude Partition Image" 
            
        config GSDC_SPIFFS_INCLUDE_PARTITION_IMAGE
            bool "Include Partition Image" 
    endchoice
endmenu
```

## main/Kconfig.projbuild
```kconfig
menu "GSDC IIC Example Configuration"

orsource "../components/spiffs_file/Kconfig"
orsource "../components/gsdc_iic/Kconfig"

if GSDC_IIC_IS_MASTER
    config GSDC_IIC_SHOW_RECEIVED_DATA 
        bool "Send the received data to the output stream"
        default n
        help
            Enable this option to show the received data in the monitor when connected
endif

orsource "../components/led_controller/Kconfig"

endmenu
```
